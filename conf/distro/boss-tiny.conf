## conf/distro/boss-tiny.conf
```bitbake
require conf/distro/poky-tiny.conf

# Set the name of distro
DISTRO = "boss-tiny"

# Needed overwrites of poky-tiny
PREFERRED_PROVIDER_virtual/kernel = "linux-raspberrypi"
IMAGE_FSTYPES_raspberrypi3 = "tar.bz2 ext3 rpi-sdimg"
```

## conf/layer.conf
```bitbake
# We have a conf and classes directory, add to BBPATH
BBPATH .= ":${LAYERDIR}"

# We have recipes-* directories, add to BBFILES
BBFILES += "${LAYERDIR}/recipes-*/*/*.bb \
            ${LAYERDIR}/recipes-*/*/*.bbappend"


BBFILE_COLLECTIONS += "meta-boss"
BBFILE_PATTERN_meta-boss = "^${LAYERDIR}/"
BBFILE_PRIORITY_meta-boss = "9"

LAYERSERIES_COMPAT_meta-boss = "sumo warrior"
```
